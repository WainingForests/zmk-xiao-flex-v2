## config/boards/shields/promicro/Kconfig.defconfig
```kconfig
if SHIELD_PROMICRO_RIGHT

config ZMK_KEYBOARD_NAME
    default "skree_customs"

config ZMK_SPLIT_ROLE_CENTRAL
    default y

endif

if SHIELD_PROMICRO_LEFT || SHIELD_PROMICRO_RIGHT

config ZMK_SPLIT
    default y

endif
```

## config/boards/shields/promicro/Kconfig.shield
```kconfig
# config SHIELD_PROMICRO
#     bool

config SHIELD_PROMICRO_LEFT
    def_bool $(shields_list_contains,promicro_left)
#     select SHIELD_PROMICRO

config SHIELD_PROMICRO_RIGHT
    def_bool $(shields_list_contains,promicro_right)
#     select SHIELD_PROMICRO
```

## config/boards/shields/skreetyl_cc/Kconfig.defconfig
```kconfig
if SHIELD_SKREETYL_CC_LEFT

config ZMK_KEYBOARD_NAME
    default "skreetyl_cc"

config ZMK_SPLIT_ROLE_CENTRAL
    default y

endif

if SHIELD_SKREETYL_CC

config ZMK_SPLIT
    default y

endif
```

## config/boards/shields/skreetyl_cc/Kconfig.shield
```kconfig
config SHIELD_SKREETYL_CC
    bool

config SHIELD_SKREETYL_CC_LEFT
    def_bool $(shields_list_contains,skreetyl_cc_left)
    select SHIELD_SKREETYL_CC

config SHIELD_SKREETYL_CC_RIGHT
    def_bool $(shields_list_contains,skreetyl_cc_right)
    select SHIELD_SKREETYL_CC
```

## config/boards/shields/xiao-flex-v2/Kconfig.defconfig
```kconfig
if SHIELD_xiao-flex-v2_LEFT

config ZMK_KEYBOARD_NAME
    default "Xiao-Flex"

config ZMK_SPLIT_ROLE_CENTRAL
    default y

endif

if SHIELD_xiao-flex-v2

config ZMK_SPLIT
    default y

endif
```

## config/boards/shields/xiao-flex-v2/Kconfig.shield
```kconfig
config SHIELD_xiao-flex-v2
    bool

config SHIELD_xiao-flex-v2_LEFT
    def_bool $(shields_list_contains,xiao-flex-v2_left)
    select SHIELD_xiao-flex-v2

config SHIELD_xiao-flex-v2_RIGHT
    def_bool $(shields_list_contains,xiao-flex-v2_right)
    select SHIELD_xiao-flex-v2
```

## config/boards/shields/xiao_flex_v2/boards/seeeduino_xiao_ble.conf
```kconfig
CONFIG_SPI=y
CONFIG_ZMK_MOUSE=y
# Set NFC Pins on Xaio as GPIO - Do this only once then comment out
#CONFIG_NFCT_PINS_AS_GPIOS=y
```
