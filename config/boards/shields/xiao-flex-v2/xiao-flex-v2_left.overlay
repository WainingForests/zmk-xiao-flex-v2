// 6x5_manuform_left.overlay

#include "6x5_manuform.dtsi" 

&kscan0 {
    col-gpios
        = <&gpio1 00 GPIO_ACTIVE_HIGH> 
        , <&xiao_d 10 GPIO_ACTIVE_HIGH> 
        , <&xiao_d 9 GPIO_ACTIVE_HIGH> 
        , <&xiao_d 8 GPIO_ACTIVE_HIGH> 
        , <&xiao_d 7 GPIO_ACTIVE_HIGH> 
        , <&gpio0 09 GPIO_ACTIVE_HIGH>
        ;
};
