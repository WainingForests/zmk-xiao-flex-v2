// skreetyl_cc_right.overlay

#include "skreetyl_cc.dtsi"

&default_transform {
    col-offset = <6>;
};

&kscan0 {
    col-gpios
		= <&xiao_d 11 GPIO_ACTIVE_HIGH>
		, <&xiao_d 10 GPIO_ACTIVE_HIGH>
		, <&xiao_d 9 GPIO_ACTIVE_HIGH>
		, <&xiao_d 8 GPIO_ACTIVE_HIGH>
		, <&gpio0 9 GPIO_ACTIVE_HIGH>
		, <&gpio1 0 GPIO_ACTIVE_HIGH>
        ;
};
